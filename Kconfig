## west.yml
```yaml
manifest:
  version: 0.7

  # Uncomment and replace MODULE_NAME with module repository name.
  # self:
    # Where this repository should be cloned to.
    # path: MODULE_NAME
```
